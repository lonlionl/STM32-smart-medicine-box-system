/**
  ******************************************************************************
  * @file    main.c
  * @brief   智能药箱系统 —— 程序总入口
  ******************************************************************************
  * 一、系统做什么
  *   1) 定时开盒: 7 个药盒 x 7 天 x 每天最多 4 个时间点, 到点由舵机开盖;
  *   2) 到点提醒: 开盒同时蜂鸣 60 秒, 按任意键手动停止;
  *   3) 云端互联: 华为云 MQTT 上报服药记录, 接收远程开盒/远程定时命令;
  *   4) 本地界面: TFTLCD 显示时间、WiFi/云连接状态、7 个药盒状态与分级菜单;
  *   5) 掉电不丢: 定时配置存在片内 Flash 最后一页, 带 CRC32 校验。
  *
  * 二、硬件接线(正点原子精英板 STM32F103ZET6)
  *   USART1  : PA9 / PA10      调试串口, printf 输出到这里, 115200
  *   USART2  : PA2 / PA3       接 ESP-01S(跑 AT 固件), 115200
  *   PCA9685 : PB6(SCL)/PB7(SDA) 舵机驱动板 —— 注意是**软件模拟 I2C**, 不是硬件 I2C 外设
  *   蜂鸣器  : PB8             高电平有效
  *   按键    : PF0~PF4         设置/确认/加/减/返回, 低电平有效
  *   TFTLCD  : FSMC 并口       ILI9488 320x480
  *
  * 三、本文件的组织结构
  *   前半段是**上电初始化**(顺序很重要, 见各步骤注释);
  *   后半段是**主循环**(5 个步骤, 全部非阻塞)。
  *
  * 四、为什么主循环里一个 delay 都不能有
  *   本系统没有 RTOS, 全靠"主循环高频轮询 + 状态机"实现并发效果:
  *   舵机开盒、蜂鸣倒计时、按键响应、界面刷新、云端收发必须同时推进。
  *   只要在主循环里插入一次阻塞延时(例如 delay(60 秒) 等蜂鸣结束),
  *   按键会失灵、云端会掉线、界面会卡死。所以所有"等待"都做成
  *   "记录时刻 + 每轮比较 Tick"的形式(见 timer.h 的用法)。
  ******************************************************************************
  */
#include "stm32f10x.h"
#include "misc.h"
#include "timer.h"
#include "usart.h"
#include "lcd.h"
#include "key.h"
#include "beep.h"
#include "rtc.h"
#include "flash.h"
#include "pca9685.h"
#include "mqtt_huawei.h"
#include "app.h"
#include "menu.h"
#include <stdio.h>

/* ==================== 界面用中文字符串 ====================
 * 为什么写成 "\xD6\xC7\xDC..." 这种字节转义, 而不直接写中文?
 *   因为字符串最终要按 GBK 送到 LCD 字库去查字形。若直接写中文,
 *   编译器会按"源文件编码"来解释这些字节, 一旦某个工具把源文件存成
 *   UTF-8, 屏幕就会出现乱码。改成显式字节转义后, 无论编辑器怎么存,
 *   编译结果都一样, 从根上避免这个坑。
 *   (注意: 这样写也让这三行本身不受文件编码影响 —— 它们是代码, 不是注释。)
 *
 * 各字符串含义:
 *   STR_BOOT_TITLE = "智能药箱系统 启动"
 *   STR_INITING    = "正在初始化..."
 *   STR_READY      = "系统初始化完成, 进入主循环"
 */
#define STR_BOOT_TITLE  "\xD6\xC7\xC4\xDC\xD2\xA9\xCF\xE4\xCF\xB5\xCD\xB3\x20\xC6\xF4\xB6\xAF"   /* 串口启动横幅首行 */
#define STR_INITING    "\xD5\xFD\xD4\xDA\xB3\xF5\xCA\xBC\xBB\xAF\x2E\x2E\x2E"                    /* 开机画面上屏的提示文字 */
#define STR_READY      "\xCF\xB5\xCD\xB3\xB3\xF5\xCA\xBC\xBB\xAF\xCD\xEA\xB3\xC9\x2C\x20\xBD\xF8\xC8\xEB\xD6\xF7\xD1\xAD\xBB\xB7" /* 初始化完成的串口提示 */

/**
  * @brief  程序入口: 依次初始化各外设, 然后进入永不退出的主循环
  * @retval 永不返回(死循环); 正常运行时不会走到 return
  *
  * 初始化顺序的设计理由(改动时请留意依赖关系):
  *   1) 先配中断优先级分组 —— 后面所有外设中断的优先级都受它影响, 必须最先做;
  *   2) 再启 1ms 系统滴答 —— 后续所有"非阻塞等待"都依赖它计时;
  *   3) 然后开串口并打印横幅 —— 让后面每一步的成败都能在串口日志里看到;
  *   4) 再初始化显示屏, 以便把初始化过程可视化(开机画面);
  *   5) 舵机/蜂鸣器/按键这类"执行器与输入"放在显示之后 ——
  *      舵机必须在上电时就归零, 否则可能停在任意角度挡住盒盖;
  *   6) RTC 必须在 App_Init 之前 —— App_Init 要用当前时间判断配置是否有效;
  *   7) App_Init 必须在 MQTT_Init 之前 —— 保证云端第一条消息到达时配置已就绪;
  *   8) MQTT_Init 放最后 —— 它一旦启动就会开始连 WiFi, 耗时最长且不阻塞,
  *      放在最后可以让前面的界面尽早显示出来, 用户不会面对黑屏等待。
  */
int main(void)
{
    /* ---------- 中断优先级分组: 2 位抢占优先级 + 2 位子优先级 ----------
     * 选 Group_2 是因为本工程只需要区分"串口接收"比"系统滴答"更紧急,
     * 两级分组足够, 也便于给每个中断留出子优先级余地。 */
    NVIC_PriorityGroupConfig(NVIC_PriorityGroup_2);

    /* ---------- 基础设施: 滴答与串口 ---------- */
    Timer_Init();                       /* 启动 SysTick, 每 1ms 中断一次累加计数 */
    USART_InitAll();                    /* 初始化 USART1(调试) 与 USART2(ESP-01S) */

    /* 打印启动横幅, 便于确认程序确实跑起来了、串口配置正确 */
    printf("\r\n========================================\r\n");
    printf("        %s\r\n", STR_BOOT_TITLE);
    printf("========================================\r\n");

    /* ---------- 显示屏初始化 ---------- */
    LCD_Init();
    printf("LCD controller ID: 0x%04X\r\n", LCD_ReadID());   /* 正常应打印 0x9488 */

    /* 开机画面: 大字标题 + 小字"正在初始化", 让用户知道设备已通电在工作 */
    LCD_Clear(WHITE);
    /* 注意 24u * 6u 是按"6 个 24 像素宽的汉字"硬算出来的居中位置。
       它成立的前提是 STR_BOOT_TITLE 恰好 6 个汉字、且 24 号表里每字都是 24 宽。
       以后若改标题文案（字数变了或混入 ASCII），这个算式必须跟着改，
       否则标题会明显偏心 —— 这是本行已知的脆弱点。
       （下面 16 号那行用的是 LCD_TextWidth16() 实测宽度，没有这个问题。） */
    LCD_ShowText24((LCD_W - 24u * 6u) / 2u, 110u, STR_BOOT_TITLE, BLUE, WHITE);
    LCD_ShowText16((LCD_W - LCD_TextWidth16(STR_INITING)) / 2u, 170u,
                   STR_INITING, BLACK, WHITE);

    /* ---------- 执行器与输入设备 ---------- */
    PCA9685_Init();                     /* 舵机驱动板: 软件 I2C + 50Hz PWM */
    PCA9685_ResetAll();                 /* 7 路舵机全部归 0 度(关盖), 上电即处于安全状态 */
    Beep_Init();                        /* 蜂鸣器(PB8), 仅配置 GPIO, 不发声 */
    Key_Init();                         /* 5 个按键(PF0~PF4), 内部上拉 */

    /* ---------- 时间与应用层 ---------- */
    RTC_Init();                         /* RTC 走时: 优先 LSE 32.768kHz, 起振失败则降级 LSI */
    App_Init();                         /* 读 Flash 定时配置; 无效则写默认配置(1 号盒 周一 08:00) */
    Menu_Init();                        /* 初始化菜单状态机, 绘制主界面 */
    MQTT_Init();                        /* 初始化云链路: 注册回调、拼主题、状态置 IDLE(空闲) */

    printf("%s\r\n", STR_READY);

    /* ==================== 主循环(前台轮询, 全程非阻塞) ====================
     * 五步的顺序是有讲究的, 不要随意调换:
     *   按键 -> 界面 -> 业务 -> 蜂鸣 -> 云端
     * 按键放最前, 保证用户操作响应最及时; 云端放最后, 因为它最耗时(要收发串口),
     * 但它是非阻塞的, 只是"推进一下状态机"就返回。 */
    while (1)
    {
        /* ---------- ① 按键扫描(含消抖与长按连发) ---------- */
        uint16_t keys = Key_Scan();
        if (keys)
        {
            /* 蜂鸣期间按任意键 = 手动确认服药: 先停蜂鸣, 并把所有已开的盒关回去。
             * 放在 Menu_OnKey 之前, 是为了让"停止提醒"优先于界面导航 ——
             * 用户被吵到时随手按任何键都应该能立刻安静下来。 */
            if (Beep_IsActive())
            {
                Beep_Stop();
                /* 关盒: 舵机回到 0 度, 同时上报云端让手机端复位显示 */
                App_CloseAllBoxes();
            }
            /* 界面菜单状态机: 依据当前界面与按键决定跳转/改值/保存 */
            Menu_OnKey(keys);
        }

        /* ---------- ② 界面周期刷新 ----------
         * 内部按"脏标志"判断, 只有时间秒数、连接状态或药盒状态变了才真正重绘,
         * 避免每轮都刷全屏浪费 FSMC 带宽并造成闪烁。 */
        Menu_Tick();

        /* ---------- ③ 业务调度: 定时匹配与跨天复位 ----------
         * 内部用"绝对分钟数"节流, 每分钟只做一次 7 盒 x 4 槽的比对,
         * 命中则开盒(舵机+蜂鸣+上报)。 */
        App_Process();

        /* ---------- ④ 蜂鸣倒计时, 并在"自动响完"时关盒 ----------
         * 注意区分两种结束方式:
         *   - 按键停止: 已在 ① 里处理过, 会立刻关盒;
         *   - 到点自动停: 就在这里用"下降沿"检测出来, 再关盒。
         * beepWasActive 是 static 局部变量, 记录上一轮的蜂鸣状态,
         * 只在"上一轮在响、这一轮不响了"时才触发一次关盒动作。 */
        {
            static uint8_t beepWasActive = 0;
            if (Beep_IsActive()) beepWasActive = 1;
            Beep_Process();
            if (beepWasActive && !Beep_IsActive())
            {
                beepWasActive = 0;
                App_CloseAllBoxes();
            }
        }

        /* ---------- ⑤ 云端链路推进 ----------
         * 内部先调 ESP_Process() 跑 AT 驱动(收字节、匹配应答、推进发布),
         * 再跑 12 状态连接状态机: 空闲->连 WiFi->NTP 校时->连 MQTT->订阅->就绪,
         * 断线则 5 秒退避后自动重连。整个过程不阻塞主循环。 */
        MQTT_Process();
    }
}
