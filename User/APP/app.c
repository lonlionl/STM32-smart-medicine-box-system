/**
  ******************************************************************************
  * @file    app.c
  * @brief   应用层实现: 药盒状态管理、定时触发调度、开盒/关盒协议
  ******************************************************************************
  * 模块职责(应用层的任务 = 把 BSP 驱动"编排"成一套完整业务流程):
  *   1) 配置管理: 上电从 Flash 读定时配置, 配置无效则生成默认配置并写回;
  *   2) 状态管理: 维护 7 个药盒的"待开/已开"状态, 每天零点自动复位;
  *   3) 触发调度: 主循环周期调用, 每分钟比对一次"时:分", 命中就开盒;
  *   4) 动作协调: 开盒 = 舵机转 90 度 + 蜂鸣 60 秒 + 界面提示 + 云端上报。
  *
  * 数据流(单向, 便于排查问题):
  *   Flash(g_Cfg) --每分钟比对--> App_Process --> App_OpenBox
  *   App_OpenBox --> PCA9685(舵机) / Beep(蜂鸣) / Menu(界面) / MQTT(云平台)
  *   云端命令 --> mqtt_huawei.c --> App_OpenBox(TRIG_REMOTE) / App_RemoteSetTimer
  *
  * 关键约定(与 flash.h / rtc.h 必须一致, 改代码时请同步):
  *   - 药盒编号: 内部统一用 0~6(对应 1~7 号盒), 只在打印/上报给人看时 +1;
  *   - 星期下标: 配置数组用 0~6(0=周一), 而 RTC 的 t.weekday 是 1~7, 需减 1;
  *   - hour[][] == 0xFF 表示该时间点"未设置"; min[][] 没有哨兵(0 分是合法值);
  *   - 时间统一以 Unix 时间戳(秒)为准, NTP 校时后 RTC 里存的是北京时间。
  ******************************************************************************
  */
#include "app.h"          /* 本模块接口: BOX_NUM/BOX_MAX_TIMES/状态与触发方式枚举 */
#include "flash.h"        /* g_Cfg 定时配置 + Flash_ReadConfig/Flash_SaveConfig */
#include "pca9685.h"      /* 舵机驱动: 开盒/关盒的实际动作 */
#include "beep.h"         /* 蜂鸣器: 开盒后的 60 秒提醒 */
#include "menu.h"         /* LCD 界面: 药盒状态刷新与文字提示 */
#include "mqtt_huawei.h"  /* 华为云 MQTT: 上报服药记录/关闭信号 */
#include "rtc.h"          /* 实时时钟: 取时间戳、时/分、星期 */
#include <stdio.h>        /* printf/sprintf: 串口日志与界面提示文本 */
#include <string.h>       /* memset: 初始化与清空时间点 */

/* ---------------------------------------------------------------------------
 * 药盒状态数组(非 static, 供 menu.c 读取以决定界面显示"已打开/待打开")
 *   - 下标 0~6 对应 1~7 号药盒, 与 PCA9685 通道号、g_Cfg.rules[] 下标完全一致;
 *   - 取值: BOX_READY(=0) 待开启 / BOX_OPENED(=1) 本次已触发开盒;
 *   - 语义: 这是"系统已发出开盒动作"的软件记录。硬件上没有盒盖到位检测
 *     (无微动开关/霍尔), 所以它不代表盒盖在物理上真的被打开了;
 *   - 复位时机: (a) 跨天时由 App_Process 全部复位;
 *               (b) 蜂鸣期间用户按键(确认已服药)或蜂鸣自然结束时,
 *                   由 main.c 调用 App_CloseAllBoxes 全部复位。
 * ------------------------------------------------------------------------- */
uint8_t g_BoxState[BOX_NUM];

/* 每个药盒上次触发的"分钟序号", 用于"同一分钟绝不重复开盒"的判重
 *   - 单位: 自 1970-01-01 00:00 起的绝对分钟数 = RTC_GetEpoch() / 60,
 *     注意它不是"当天第几分钟" —— 用绝对值的好处是跨天时新旧值天然不同,
 *     不需要在零点额外清零, 也不存在"昨天 8:00 与今天 8:00 撞车"的问题;
 *   - 初值 0 表示"上电以来还没触发过"(真实时间戳对应的分钟数远大于 0);
 *   - 为什么除了"每分钟只检查一次"还要再判重一次:
 *       1) RTC 可能被 NTP 校时往回调, 使 checkMin 回到曾经出现过的值,
 *          此时"分钟序号变了才检查"这层节流会失效, 判重仍能挡住重复开盒;
 *       2) 两层保护各管一件事: 外层节流省 CPU, 内层判重保证动作只发生一次,
 *          将来即使有人改了节流逻辑, 重复开盒也不会发生。 */
static uint32_t g_LastTriggerMin[BOX_NUM];
/* 上次检测到的"天序号"(= RTC_GetEpoch() / 86400), 用于判断是否跨天
 *   - 初值 0: 上电后第一次 App_Process 必然判定为"跨天", 会多做一次
 *     无害的复位和一句打印(此时状态本来就是刚初始化的), 换来的是不必
 *     再额外增加一个"首次运行"标志;
 *   - 用"天序号不等"判断跨天, 而不是判断"时==0 且 分==0", 这样即使零点
 *     那一刻主循环正卡在别处(例如等串口应答), 之后任何一轮循环都能补上复位。 */
static uint32_t g_LastDay = 0;

/**
  * @brief  初始化应用层: 复位药盒状态、读取 Flash 定时配置
  * @param  无
  * @retval 无
  * @note   配置无效时写入默认配置(药盒1 每天 8:00), 便于演示
  *
  * 原理/设计思路:
  *   1) 先复位内存状态、再读 Flash: 无论 Flash 里是什么内容, 上电初态一定
  *      是"7 个盒子都待开", 系统的可用性不依赖 Flash 数据是否完好;
  *   2) 配置无效(magic 不对 / CRC 校验失败, 即首次烧录或数据损坏)时必须
  *      主动生成一份合法配置写回, 否则每次上电都走"无效"分支, 界面上永远
  *      没有定时, 用户会以为程序坏了;
  *   3) 调用时机: main.c 在 RTC_Init() 之后、Menu_Init() 之前调用本函数,
  *      所以这里可以安全地用 RTC_GetEpoch() 取当前时间, 串口打印也已就绪。
  */
void App_Init(void)
{
    uint8_t i;

    /* 复位 7 个药盒的状态与判重记录; 必须在读 Flash 之前做完(见函数头说明 1) */
    for (i = 0; i < BOX_NUM; i++)
    {
        g_BoxState[i] = BOX_READY;
        g_LastTriggerMin[i] = 0;            /* 0 = "从未触发过", 见上面的变量说明 */
    }
    /* 记录"今天": 让上电后第一次 App_Process 不把当天误判成跨天,
       避免刚开机就多做一次整屏刷新(此时界面才刚初始化, 刷了也没意义) */
    g_LastDay = RTC_GetEpoch() / 86400u;

    /* 读取 Flash 定时配置; 无效则写入默认配置(药盒1 每天8点, 便于演示) */
    if (!Flash_ReadConfig(&g_Cfg))
    {
        uint8_t bi, di, ti2;
        memset(&g_Cfg, 0, sizeof(g_Cfg));   /* 先整体清零, 再逐项填合法值(避免残留垃圾) */
        g_Cfg.magic = FLASH_CFG_MAGIC;      /* 魔数必须写: SaveConfig 会把它一起算进 CRC,
                                               读回时也靠它判断"这片配置是否有效" */
        /* 关键易错点: 所有药盒的所有时间点都要初始化为"未设置"哨兵 0xFF,
           绝不能用 memset 之后的 0 —— hour==0 会被 App_Process 当成
           "每天 00:00 有一个定时", 结果每天零点 7 个盒子一起开盖蜂鸣。
           (只有 hour 需要哨兵: 判断"是否设置"只看 hour, min 保持 0 即可,
            因为 0 分本身是合法值, 无法用 0 表示"未设置") */
        for (bi = 0; bi < BOX_NUM; bi++)
            for (di = 0; di < 7u; di++)
                for (ti2 = 0; ti2 < BOX_MAX_TIMES; ti2++)
                    g_Cfg.rules[bi].hour[di][ti2] = 0xFFu;
        /* 默认: 药盒1 每天 8:00 */
        g_Cfg.rules[0].hour[0][0] = 8;      /* 只填了 day=0(周一) 的 0 号时间槽 */
        g_Cfg.rules[0].min[0][0]  = 0;      /* 精确地说默认是"药盒1 周一 8:00",
                                               其余 6 天仍保持未设置; 取 8 点是为了
                                               验收时不必等到深夜就能看到开盒动作 */
        if (Flash_SaveConfig(&g_Cfg))
        {
            printf("[FLASH] 无效配置, 已写入默认配置(药盒1 每天8点)\r\n");
        }
        else
        {
            /* 写回失败不影响本次运行: 内存里的 g_Cfg 已经是合法配置,
               电池支持下能正常工作, 只是下次上电又要重建一次默认配置 */
            printf("[FLASH] 默认配置写入失败!\r\n");
        }
    }
    else
    {
        /* 走到这里说明 Flash 里的 magic 与 CRC 都校验通过, g_Cfg 已被填好 */
        printf("[FLASH] 定时配置读取成功\r\n");
    }

    /* 调试: 打印药盒1/2 周一的前 4 个时间点(确认 FLASH 数据正确) */
    {
        /* 只取前 2 个盒子、只取周一(day=0)的 4 个槽位, 用一两行串口输出就能
           判断配置是否符合预期: 打印出 255 就代表该时间点"未设置"(=0xFF);
           (unsigned) 强转是 Keil ARMCC 上 printf 可变参数取值的稳妥写法 */
        uint8_t bi;
        for (bi = 0; bi < 2u; bi++)
        {
            printf("[APP] box%u d0 h=%u,%u,%u,%u\r\n", (unsigned)bi + 1u,
                   (unsigned)g_Cfg.rules[bi].hour[0][0],
                   (unsigned)g_Cfg.rules[bi].hour[0][1],
                   (unsigned)g_Cfg.rules[bi].hour[0][2],
                   (unsigned)g_Cfg.rules[bi].hour[0][3]);
        }
    }
}

/**
  * @brief  打开药盒(开盖+蜂鸣提醒+上报记录)
  * @param  box  药盒编号 0~6
  * @param  mode 触发方式: TRIG_TIMER=定时触发 TRIG_REMOTE=远程手动
  * @retval 无
  *
  * 原理/设计思路:
  *   - 这是"开盒"的唯一入口: 定时调度(App_Process)与云端远程命令
  *     (mqtt_huawei.c 收到 remote_open_box 后)都调用它。两条路径共用同一套
  *     动作, 可以避免各写一份而出现行为不一致(例如远程开盒忘记蜂鸣);
  *   - 动作顺序: 先改状态 -> 动舵机 -> 启蜂鸣 -> 刷界面 -> 最后上报。
  *     状态放在最前面, 保证后续每一步的耗时(软件 I2C 写 PCA9685、串口 AT 发送)
  *     都不会让界面读到过期的"待开"状态;
  *   - 函数里没有任何阻塞等待: 蜂鸣只是启动一个倒计时(由主循环的 Beep_Process
  *     递减关闭), 上报在未联网/发送忙时由内部直接丢弃, 所以本函数不会拖慢主循环;
  *   - 重复开盒的取舍: 若前一个盒子还在蜂鸣提醒期间又来了新的开盒请求,
  *     Beep_Start 会把 60 秒倒计时重新计时(以最后一次开盒为准), 提醒窗口被延长;
  *     蜂鸣结束时 main.c 统一调用 App_CloseAllBoxes, 也就是说"后开的盒子会跟着
  *     前一个盒子一起等这次提醒结束再关盖" —— 全系统只有一个提醒窗口, 这是有意
  *     为之的简化设计, 避免多路蜂鸣/多路关盖时序互相打架。
  */
void App_OpenBox(uint8_t box, uint8_t mode)
{
    char msg[24];                           /* 界面提示文本缓冲: 最长的 "远程开盒:药盒7"
                                               按 GBK 双字节算约 15 字节, 24 字节足够,
                                               sprintf 不会越界 */

    /* 边界检查: box 可能来自云端 JSON(不可信输入)或内部循环;
       越界既会写坏 g_BoxState 之后的内存, 也会让 PCA9685 收到非法通道号 */
    if (box >= BOX_NUM) return;

    g_BoxState[box] = BOX_OPENED;           /* 先置"已打开": 下一轮 Menu_Tick 就能显示出新状态 */

    /* 动作 1: 舵机开盖 —— 通道号与药盒号一一对应(通道 0~6 接 1~7 号盒的舵机) */
    PCA9685_SetAngle(box, SERVO_OPEN_ANGLE);/* 转到 SERVO_OPEN_ANGLE=90 度, 即开盖位置 */
    /* 动作 2: 蜂鸣提醒 —— 这里只"启动倒计时"并立即返回, 60 秒后由主循环
       里的 Beep_Process 自动关闭, 期间按键、调度、联网都照常工作 */
    Beep_Start(BEEP_SECONDS);               /* 蜂鸣 BEEP_SECONDS=60 秒 */

    /* 触发方式只影响"文字": 串口日志、界面提示、云端记录的内容;
       盒子的动作完全相同, 这样两条触发链路的表现天然一致。
       (int)box + 1 是把内部编号 0~6 换算成人看的 1~7 号 */
    if (mode == TRIG_TIMER)
    {
        printf("[定时] %d号药盒定时触发\r\n", (int)box + 1);
        sprintf(msg, "定时触发:药盒%d", (int)box + 1);
    }
    else
    {
        printf("[远程] %d号药盒远程开盒\r\n", (int)box + 1);
        sprintf(msg, "远程开盒:药盒%d", (int)box + 1);
    }

    /* 只置"药盒状态变了"的脏标志, 真正的重绘交给 Menu_Tick 在下一轮主循环做:
       避免在开盒动作里直接整屏重绘, 减少闪烁和一次性的耗时 */
    Menu_NotifyBoxChange();                 /* 刷新界面药盒状态 */
    Menu_ShowMainMsg(msg);                  /* 界面顶部提示(若干秒后自动消失) */
    MQTT_PublishRecord(box, mode);          /* 上报服药记录(box_num/chufa_text/chufa_time);
                                               没联网或发送忙时内部直接丢弃, 不会阻塞开盒 */
}

/**
  * @brief  关闭全部药盒(复位): 舵机归位 0 度, 状态复位, 上报关闭信号
  * @param  无
  * @retval 无
  *
  * 原理/设计思路:
  *   - 这是"开盒"的逆操作, 也是整套提醒流程的收尾: 由 main.c 在两处调用 ——
  *     蜂鸣期间用户按键(表示已服药, 手动结束), 以及蜂鸣自然结束时(自动收尾);
  *   - 为什么状态和舵机必须成对复位: 只改状态, 盒盖会一直开着; 只关舵机,
  *     界面会永远显示"已打开", 第二天用户也看不出到底提醒过没有;
  *   - 为什么一次复位全部而不是逐个关: 7 路舵机共用一片 PCA9685, 统一复位
  *     最简单可靠, 也贴合业务语义(本次提醒到此结束);
  *   - 注意本函数不碰蜂鸣器: 手动结束时由 main.c 先调 Beep_Stop, 自动结束时
  *     蜂鸣本来就已停; 它也不上报"服药记录", 避免凭空多出一条开盒记录。
  */
void App_CloseAllBoxes(void)
{
    uint8_t i;

    for (i = 0; i < BOX_NUM; i++)
    {
        g_BoxState[i] = BOX_READY;          /* 逻辑状态先回到"待开" */
        PCA9685_SetAngle(i, 0u);            /* 舵机回 0 度 */
    }
    printf("[系统] 全部药盒已复位关闭\r\n");
    /* 只上报一个 box_num=0 的"全关"信号, 让手机 App 把界面上的开盒状态清掉:
       比逐盒上报省流量, 也不会让 App 误以为某个盒子被开过 */
    MQTT_PublishClose();                    /* 上报"已关闭", 手机 App 同步 */
    /* 内部会先判断"当前是否在主界面", 不在主界面时什么都不做,
       所以这里调用是安全的, 不会把用户正在操作的设置界面顶掉 */
    Menu_RefreshMain();
}

/**
  * @brief  远程修改定时(旧版 set_schedule 命令兼容)
  * @param  box  药盒编号 0~6
  * @param  day  星期 0~6 (0=周一)
  * @param  hour 小时 1~24, 0=清除该天
  * @retval 无
  * @note   转换为"该天第一个时间点"规则, 覆盖该盒该天原有设置
  *
  * 原理/设计思路:
  *   - 云端产品模型里的 set_schedule 是"一次只设一个时间点"的旧接口, 而本地
  *     规则是"每天最多 4 个时间点", 两者粒度不同, 这里采用"覆盖式"策略:
  *     先清空该盒该天的 4 个槽位, 再把 hour 写进第 0 个槽位;
  *   - 为什么必须"先清空再覆盖": 如果只写第 0 个槽位, 原先的第 1~3 个时间点
  *     还会继续触发(调度只按分钟比对, 不区分这个时间点来自哪条命令), 用户会
  *     以为"我明明改了定时, 怎么还在旧时间响", 排查起来非常费劲;
  *   - 调用者: mqtt_huawei.c 收到 set_schedule 命令后调用, 并已把云端的
  *     box 1~7 / day 1~7 各减 1, 转成本函数要求的 0~6;
  *   - 新版做法是整包下发 schedule_1~7(在 mqtt_huawei.c 中解析)后统一保存,
  *     本函数保留给旧版手机 App 和单独调试使用。
  */
void App_RemoteSetTimer(uint8_t box, uint8_t day, uint8_t hour)
{
    /* 入参校验: 三个值都来自云端 JSON, 属不可信输入。越界会写坏 g_Cfg,
       更糟的是紧接着被写进 Flash, 造成掉电也不恢复的配置损坏, 所以先挡住。
       注意上界是 hour > 24 而不是 > 23: 本接口约定 0 表示"清除该天",
       1~24 表示 1~24 点(24 点即次日 0 点), 合法输入比本地存储的 0~23 多一个。
       day 的上界这里写作字面量 7(与 BOX_MAX_TIMES 无关, 是"一周 7 天") */
    if (box >= BOX_NUM || day >= 7 || hour > 24)
    {
        return;
    }
    /* 先清空该天 4 个时间点: hour 用 0xFF 哨兵而不是 0(否则被清掉的槽位
       会变成"每天 00:00"的定时, 原因见 App_Init 里的说明);
       min 清 0 即可, 因为"是否设置"只看 hour */
    memset(g_Cfg.rules[box].hour[day], 0xFF, BOX_MAX_TIMES);
    memset(g_Cfg.rules[box].min[day], 0, BOX_MAX_TIMES);
    if (hour != 0u)                  /* 0 = 清除该天 */
    {
        /* 24 点归一到 0 点(云端用 1~24 表示 0~23 点);
           时间点固定落在第 0 个槽位, 分钟固定为 0 分 —— 这就是"该天只有一个
           时间点"的落地形式; hour==0 时整个 if 不执行, 于是该天保持全 0xFF,
           效果就是"这一天没有任何定时" */
        g_Cfg.rules[box].hour[day][0] = (uint8_t)((hour == 24u) ? 0u : hour);
        g_Cfg.rules[box].min[day][0]  = 0;
    }
    /* g_Cfg 是内存中唯一的配置副本, 改完必须立刻写回 Flash 才能掉电保持;
       Flash_SaveConfig 内部会重算 CRC、擦写扇区并回读校验 */
    if (Flash_SaveConfig(&g_Cfg))
    {
        /* 打印里的 box+1 / day+1 是把内部下标换算成人看的 1~7 */
        printf("[远程] 定时修改成功: 药盒%d 星期%d %d时\r\n",
               (int)box + 1, (int)day + 1, (int)hour);
        Menu_ShowMainMsg("远程设置成功");
    }
    else
    {
        /* 保存失败: 内存里的改动仍然生效(本次运行), 但掉电会丢, 所以要提示 */
        printf("[远程] 定时保存失败\r\n");
        Menu_ShowMainMsg("设置无效");
    }
    /* 让主界面重新计算并显示各盒的"最近定时"; 定时规则上报云端由
       mqtt_huawei.c 在回复命令后自动逐盒上报(schedule_1~7), 这里不重复上报 */
    Menu_RefreshMain();
}

/**
  * @brief  主循环周期调用: 每天零点复位药盒状态 + 每分钟检查定时触发
  * @param  无
  * @retval 无
  *
  * 原理/设计思路:
  *   - 调度模型: "轮询 + 两级节流", 完全不用定时器中断, 逻辑集中在一处,
  *     便于调试(在任意一行打断点就能看清整个调度过程);
  *   - 本函数被 main.c 的主循环高频调用(每轮几毫秒), 内部有两级节流:
  *       第 1 级 s_LastCheckMin    -> 同一分钟内只进入匹配逻辑一次(省 CPU);
  *       第 2 级 g_LastTriggerMin  -> 同一分钟内绝不重复开盒(防重复动作);
  *     两级都用"绝对分钟序号"(epoch/60)比较, 而不是"当天第几分钟",
  *     所以跨天时新旧值天然不相等, 零点不需要额外清零这两个变量;
  *   - 为什么不用"每到整分就触发": 主循环没有严格周期, 用"分钟序号变了就检查"
  *     的方式, 即使某一轮循环晚了几百毫秒甚至漏跑几轮, 该分钟内的下一次循环
  *     仍会补上检查, 不会漏掉这次定时;
  *   - 已知取舍: 若整个分钟被跳过(例如 NTP 校时把时间一次往前调了几分钟),
  *     被跳过的那几分钟里的定时不会补触发 —— 轮询式调度无法"回放"已经过去
  *     的时间点。药盒提醒属于"错过就不再补"的场景, 这个取舍是可接受的;
  *   - 跨天复位: 让界面上的"已打开"标记每天归零, 否则盒子只要开过一次就永远
  *     显示"已打开", 用户无法判断今天到底提醒了没有。
  */
void App_Process(void)
{
    /* now: 32 位时间戳, 用来做"分钟/天"的节流比较(整数除法比读 RTC 字段便宜);
       t:   由 RTC 换算好的年月日时分秒 + 星期, 供匹配和时间点显示使用 */
    uint32_t now = RTC_GetEpoch();
    RtcTime_t t;
    uint32_t curDay, dayIdx;    /* curDay=天序号(判断跨天); dayIdx=星期下标 0~6 */
    uint8_t  b;                 /* 药盒循环变量 0~6 */

    RTC_GetTime(&t);
    curDay = now / 86400u;      /* 一天 86400 秒: 整除即得"自 1970 起的第几天" */

    /* 说明: now 与 t 是两次独立读取, 极端情况下(恰好在这两行之间跨过整分/整天)
       两者会不一致。这里不特殊处理也不影响正确性 —— 分钟匹配用的是 t.hour/t.minute,
       而判重用的一直是由 now 推出的 checkMin, 所以最坏只是提前或推迟 1 秒判定,
       绝不会因为这次"读取撕裂"而重复开盒。 */

    /* ---- 跨天: 复位所有药盒状态 ---- */
    if (curDay != g_LastDay)
    {
        g_LastDay = curDay;     /* 先更新天序号, 保证这段复位逻辑每天只跑一次 */
        for (b = 0; b < BOX_NUM; b++)
        {
            g_BoxState[b] = BOX_READY;      /* 新的一天, 7 个盒子全部回到"待开" */
        }
        printf("[系统] 新的一天, 药盒状态已复位\r\n");
        Menu_RefreshMain();     /* 主界面重绘一次, 把 7 行状态灯刷回"待打开" */
    }

    /* ---- 定时触发检查: 每分钟匹配时间点(时:分) ---- */
    {
        /* static 局部变量: 只在本函数内可见, 不污染全局命名空间, 同时跨调用保持;
           初值 0 -> 上电后第一轮循环必然满足 checkMin != 0, 于是立即检查一次,
           做到"开机即开始工作"(若开机时刻正好命中某个时间点, 会立刻开盒) */
        static uint32_t s_LastCheckMin = 0;
        uint32_t checkMin = now / 60u;      /* 当前"绝对分钟序号", 与 g_LastTriggerMin 同量纲 */

        if (checkMin != s_LastCheckMin)   /* 每分钟只检查一次 */
        {
            uint8_t ti;

            s_LastCheckMin = checkMin;    /* 先记录再检查, 保证本分钟内不再进入这段逻辑 */
            /* RTC 的 t.weekday 是 1~7(1=周一 ... 7=周日, 见 rtc.h),
               而配置数组的星期下标是 0~6, 所以统一减 1 对齐 */
            dayIdx = (uint32_t)(t.weekday - 1u);      /* 0=周一 */
            for (b = 0; b < BOX_NUM; b++)
            {
                /* 指向本盒的规则表: 内层循环里就不必反复做二维下标寻址;
                   const 表示只读, 防止不小心改到配置 */
                const BoxRule_t *r = &g_Cfg.rules[b];
                uint8_t hit = 0;        /* 本盒"今天"是否有时间点命中当前 时:分 */

                /* 遍历该盒当天的 4 个时间点, 匹配当前时:分
                   (只查 dayIdx 这一行, 因此周一设的定时不会在周二触发) */
                for (ti = 0; ti < BOX_MAX_TIMES; ti++)
                {
                    /* 0xFF = 该时间点未设置, 直接跳过。虽然 255 本来也不会等于任何
                       合法小时(0~23), 但显式判断让"未设置"的语义写在代码里,
                       不再依赖"0xFF 不在合法时域内"这个隐式约定 */
                    if (r->hour[dayIdx][ti] == 0xFFu) continue;   /* 未设置 */
                    /* 时和分必须同时相等才算命中 */
                    if (r->hour[dayIdx][ti] == t.hour && r->min[dayIdx][ti] == t.minute)
                    {
                        hit = 1;
                        break;          /* 命中一个就够: 同一盒同一天可能有重复的时间点,
                                               外层判重已保证只开盒一次, 这里提前跳出只为省时间 */
                    }
                }
                /* 命中且本分钟未触发过 -> 开盒 */
                if (hit && g_LastTriggerMin[b] != checkMin)
                {
                    /* 先记账再动作: App_OpenBox 里的软件 I2C 写舵机、串口打印都有耗时,
                       若先动后记账, 万一耗时跨过了本轮循环, 下一轮就可能重复开盒 */
                    g_LastTriggerMin[b] = checkMin;
                    App_OpenBox(b, TRIG_TIMER);     /* 定时触发: 开盒 + 蜂鸣 + 界面提示 + 上报 */
                }
            }
        }
    }
}
