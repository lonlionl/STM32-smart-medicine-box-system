/**
  ******************************************************************************
  * @file    rtc.c
  * @brief   RTC 实时时钟模块实现(走时 + 日历换算 + NTP 校时基础)
  ******************************************************************************
  * 设计要点
  *   - RTC 计数器里直接保存 **Unix 时间戳(自 1970-01-01 00:00:00 UTC 起的秒数)**,
  *     而不是"年月日时分秒"的分字段寄存器。这样比较、相减、做定时调度
  *     都只是一次整数运算, 由 32 位秒计数到 2106 年才回绕, 够用;
  *   - 本机按北京时间使用(见文件末尾关于 NTP 的说明), 不做时区换算;
  *   - 时钟源首选外部 32.768kHz 晶振 LSE, 走时准且能被纽扣电池维持;
  *     晶振缺失/不起振时自动降级到内部 LSI, 保证"宁可走不准也不能不走";
  *   - 是否已初始化由 BKP 备份寄存器(由纽扣电池供电, 主电源掉电不丢)判断,
  *     因此正常断电重启不会把时间重置;
  *   - 日历换算采用 Howard Hinnant 的 civil_from_days / days_from_civil 算法,
  *     无循环、无查表、纯整数运算, 对 1970 年前后的日期都成立。
  *
  * 硬件与前提
  *   - PC14/PC15 接 32.768kHz 晶振(注意这两个引脚接上晶振后不可再作普通 IO);
  *   - VBAT 脚接纽扣电池, 否则主电源一断, RTC 与 BKP 一起清零,
  *     下次上电又要重新初始化时间。
  ******************************************************************************
  */
#include "rtc.h"
#include "timer.h"
#include <stdio.h>
#include <string.h>

/* ==================== 时间换算工具 ==================== */

/**
  * @brief  公历日期转"自 1970-01-01 起的天数"(Howard Hinnant 的 days_from_civil 算法)
  * @param  y 年(完整年份, 如 2026)
  * @param  m 月 1~12
  * @param  d 日 1~31
  * @retval 天数; 1970-01-01 为 0, 1970 年之前为负
  *
  * 原理(为什么这样算)
  *   把公历拆成"400 年一纪元"的循环: 每 400 年恰好 146097 天,
  *   这个常数把闰年规则(4 年一闰、100 年不闰、400 年再闰)的修正项
  *   全部吸收了, 于是纪元内部的运算可以用纯整除完成。
  *
  *   关键技巧是**把一年的起点挪到 3 月**: 令 3 月 = 第 0 月, 次年 2 月 = 第 11 月。
  *   这样 2 月 29 日就落在一年的末尾, 月长序列变成
  *   [31,30,31,30,31,31,30,31,30,31,31,28] —— 只有最后一个月是特例,
  *   于是可以用一个统一的一次式近似累加月长:
  *       day_of_year(m) = (153*m + 2) / 5
  *   式中的 153/5 = 30.6 是月平均长度, 2 是凑整偏移, 让每个月的边界正好落在整数上。
  *   代码里 m > 2 时取 m-3, 否则取 m+9, 做的正是这套月份重编号
  *   (m=3 -> 0, m=12 -> 9, m=1 -> 10, m=2 -> 11)。
  *
  *   逐行含义
  *     y -= (m <= 2)              : 把 1、2 月归到上一年(配合 3 月起算的重编号)
  *     era = (y>=0 ? y : y-399)/400 : 向下取整的 400 年纪元号;
  *                                  C 的整除向零取整, 对负数要先减 399 才等价于 floor
  *     yoe = y - era*400          : 纪元内的第几年(0~399)
  *     doy                        : 重编号后, 当天是"年"内的第几天(3 月 1 日 = 0)
  *     doe = yoe*365 + yoe/4 - yoe/100 + doy
  *                                : 纪元内的第几天, 三项分别累加平年天数、
  *                                  4 年一闰、100 年不闰的修正
  *     era*146097 + doe - 719468  : 换算到 1970-01-01 为原点的天数。
  *                                  719468 是公历元年 3 月 1 日到 1970-01-01 的天数
  *
  *   返回类型是 uint32_t 而返回值可能为负: 由调用者保证不传入 1970 年之前的日期,
  *   本项目中时间永远来自 RTC 计数器或 NTP, 不会更早。
  */
static uint32_t DaysFromCivil(int y, int m, int d)
{
    int era;
    unsigned yoe, doy, doe;

    y -= (m <= 2);                          /* 1、2 月算作上一年的第 11、12 月: 让 2 月 29 日落在一年的末尾,
                                               于是全年只有最后一个月的长度是特例 */
    era = (y >= 0 ? y : y - 399) / 400;     /* 400 年为一纪元(146097 天, 恰好涵盖全部闰年规则);
                                               C 语言整除是向零取整, 负数需先减 399 才等于向下取整 */
    yoe = (unsigned)(y - era * 400);        /* 纪元内的第几年(0~399) */
    doy = (153u * (unsigned)(m + (m > 2 ? -3 : 9)) + 2u) / 5u + (unsigned)(d - 1);
                                            /* 月份重编号: 3月->0, 4月->1 ... 12月->9, 1月->10, 2月->11;
                                               (153*m+2)/5 即 30.6*m 取整, 是月长的统一近似式,
                                               再加 d-1 得到"从 3 月 1 日起算的第几天" */
    doe = yoe * 365u + yoe / 4u - yoe / 100u + doy;
                                            /* 纪元内的第几天: 平年 365 天 + 4 年一闰 - 100 年不闰;
                                               不必再修正 400 年, 因为 400 年的补偿已经由 era*146097 承担 */
    return (uint32_t)(era * 146097 + (int)doe - 719468);
                                            /* 146097 = 400 年的总天数; 719468 = 公元元年 3 月 1 日
                                               到 1970-01-01 的天数, 这一减就得到 Unix 天数 */
}

/**
  * @brief  把"自 1970-01-01 起的天数"还原成公历日期(DaysFromCivil 的逆运算)
  * @param  z   天数, 1970-01-01 为 0
  * @param  y   输出: 年(如 2026)
  * @param  m   输出: 月 1~12
  * @param  d   输出: 日 1~31
  * @retval 无(结果通过指针返回)
  *
  * 原理: 完全照 days_from_civil 反过来推, 顺序是
  *   "先定 400 年纪元 -> 再定纪元内第几年 -> 再定年内第几天 -> 最后定月日"。
  *
  *   逐行含义
  *     z += 719468                : 先把原点从 1970-01-01 挪到公历元年 3 月 1 日,
  *                                  于是后面全程都是非负数的整数运算(Ubuntu 之前
  *                                  还在用查表法, 这里换成了纯算术)
  *     era = z / 146097           : 400 年一纪元
  *     doe = z - era*146097       : 纪元内的第几天
  *     yoe = (doe - doe/1460 + doe/36524 - doe/146096) / 365
  *                                : 纪元内的年份。这一串是"闰年修正"的紧凑写法:
  *                                  1460 ≈ 4 年、36524 ≈ 100 年、146096 ≈ 400 年,
  *                                  先按 365 平均除, 再把 4 年一闰的天数补回来,
  *                                  同时扣掉 100 年不闰、加回 400 年再闰的部分
  *     doy = doe - (365*yoe + yoe/4 - yoe/100)
  *                                : 该年内的第几天(重编号后, 3 月 1 日为 0)
  *     mp  = (5*doy + 2) / 153    : 反解月份, 就是 (153*m+2)/5 的逆运算
  *     dd  = doy - (153*mp+2)/5 + 1 : 该月第几天, +1 是因为天数从 1 开始编号而不是 0
  *     mm  = mp + (mp < 10 ? 3 : -9): 把重编号的月份还原成 3~12 月 / 次年 1~2 月
  *     *y  = yy + (mm <= 2)       : 1、2 月属于下一年(与去程的 y -= (m<=2) 对称)
  *
  *   注意: CivilFromDays 的"天"是从 3 月 1 日起算的, 而 months 的还原
  *   只依赖 mp, 与 2 月无关, 所以闰年 2 月 29 日能自然落到正确日期。
  */
static void CivilFromDays(uint32_t z, int *y, int *m, int *d)
{
    uint32_t era;
    unsigned doe, yoe, doy, mp, dd, mm;
    int yy;

    z += 719468u;                           /* 原点从 1970-01-01 挪到公元元年 3 月 1 日,
                                               之后全程非负整数运算 */
    era = z / 146097u;                      /* 400 年一纪元(146097 天) */
    doe = (unsigned)(z - era * 146097u);    /* 纪元内的第几天 */
    yoe = (doe - doe / 1460u + doe / 36524u - doe / 146096u) / 365u;
                                            /* 纪元内第几年: 1460/36524/146096 分别是 4/100/400 年的
                                               天数(近似), 用于修正闰年; 等价于依次判断
                                               y*365 + y/4 - y/100 <= doe */
    yy = (int)yoe + (int)(era * 400u);      /* 完整年份 */
    doy = doe - (365u * yoe + yoe / 4u - yoe / 100u);
                                            /* 该年内第几天(3 月 1 日为第 0 天) */
    mp = (5u * doy + 2u) / 153u;            /* 反解月份号(0 = 3 月), 是 30.6*m 近似式的逆运算 */
    dd = doy - (153u * mp + 2u) / 5u + 1u;  /* 减去本月之前的天数, +1 因为日期从 1 开始编号 */
    mm = mp + (mp < 10u ? 3u : -9u);        /* 月份号还原: 0~9 -> 3~12 月, 10~11 -> 次年 1~2 月 */
    *y = yy + (int)(mm <= 2u);              /* 1、2 月属于下一年(与去程 y -= (m<=2) 对称) */
    *m = (int)mm;
    *d = (int)dd;
}

/**
  * @brief  读取当前日期时间(把 RTC 里的时间戳拆成年月日时分秒)
  * @param  t 输出结构体指针, 由调用者提供; 本函数会把 7 个字段全部写满
  * @retval 无
  *
  * 原理: RTC 只提供一个 32 位秒计数, 拆解分三步
  *   1. days = epoch / 86400, secs = epoch % 86400
  *      —— 一天 86400 秒, 把"第几天"和"当天已过多少秒"分开;
  *   2. 用 CivilFromDays 把天数还原成年月日(见该函数注释);
  *   3. 当天秒数按 3600、60 逐级取模得到时/分/秒。
  *
  * 星期计算: 1970-01-01 是**星期四**。
  *   (days + 4) % 7 得到 0=周日 ... 6=周六(4 正好把周四映射到 4);
  *   再加 6 取模 7 再 +1, 换算成本项目约定的 1=周一 ... 7=周日。
  *   之所以不单独存星期, 是因为它完全由天数决定,
  *   派生计算永远不会与日期不一致(存字段反而会存在两份数据不同步的风险)。
  *
  * 边界: 时间戳为 0 时(误差 1970-01-01 周四)各字段为 1970-01-01 00:00:00 星期四。
  */
void RTC_GetTime(RtcTime_t *t)
{
    uint32_t epoch = RTC_GetEpoch();
    uint32_t days  = epoch / 86400u;      /* 自 1970 起的天数 */
    uint32_t secs  = epoch % 86400u;      /* 当天内的秒数 */
    int y, m, d;

    CivilFromDays(days, &y, &m, &d);

    t->year   = (uint16_t)y;
    t->month  = (uint8_t)m;
    t->day    = (uint8_t)d;
    t->hour   = (uint8_t)(secs / 3600u);
    t->minute = (uint8_t)((secs % 3600u) / 60u);
    t->second = (uint8_t)(secs % 60u);
    /* 星期: 1970-01-01 是星期四。先 (days+4)%7 把 0 对齐到周日,
       再 +6 取模 +1 换算成 1=周一 ... 7=周日 的本项目约定 */
    t->weekday = (uint8_t)(((days + 4u) % 7u + 6u) % 7u + 1u);
}

/**
  * @brief  把年月日时分秒换算成 Unix 时间戳(NTP 校时与默认时间写入都走这里)
  * @param  year   年(完整年份, 如 2026)
  * @param  month  月 1~12
  * @param  day    日 1~31
  * @param  hour   时 0~23
  * @param  minute 分 0~59
  * @param  second 秒 0~59
  * @retval 自 1970-01-01 00:00:00 起的秒数
  *
  * 原理: 时间戳 = 天数 * 86400 + 时 * 3600 + 分 * 60 + 秒
  *   其中天数由 DaysFromCivil 一次算出, 不涉及任何循环。
  *   调用者需自行保证各字段在合法范围内 —— 本函数不做范围校验,
  *   传入 13 月、32 日会得到"顺延后的合法日期", 不会报错。
  *
  * 单位与溢出: 返回值是 uint32_t, 到 2106 年回绕;
  *   中间量 days*86400 在 2099 年前远小于 2^32, 不会溢出。
  */
uint32_t RTC_ToEpoch(uint16_t year, uint8_t month, uint8_t day,
                     uint8_t hour, uint8_t minute, uint8_t second)
{
    /* 先算天数再拼当天秒数: 顺序无所谓, 但拆成两步更贴近"时间戳 = 日 + 秒"的含义 */
    uint32_t days = DaysFromCivil((int)year, (int)month, (int)day);
    return days * 86400u + (uint32_t)hour * 3600u + (uint32_t)minute * 60u + (uint32_t)second;
}

/* ==================== 读写 RTC 计数器 ==================== */

/**
  * @brief  读取当前 Unix 时间戳(秒)
  * @param  无
  * @retval 当前时间戳; RTC 未初始化时读到的是 0, 即 1970-01-01
  *
  * 原理: 直接读 RTC 的 32 位计数器(CNT)。标准库的 RTC_GetCounter 只做寄存器读取,
  *       属于纯读操作, 不需要进入配置模式, 也不会影响走时;
  *       它内部会等一次 RTC 影子寄存器同步, 保证读到的是一个完整、不撕裂的值。
  */
uint32_t RTC_GetEpoch(void)
{
    return RTC_GetCounter();
}

/**
  * @brief  写入 Unix 时间戳(校时用: 界面设置时间、NTP 同步都走这里)
  * @param  epoch 待写入的时间戳(秒)
  * @retval 无
  *
  * 原理与坑
  *   - STM32F1 的 RTC 计数器是**写保护**的: 必须先进入配置模式(CNF 位置 1)
  *     才能改写 CNT, 写完还要退出配置模式才会真正生效;
  *     标准库的 RTC_SetCounter() 已经把"进入配置模式 -> 写 CNT -> 退出配置模式"
  *     这一整套做完了, 所以这里只调它一次即可;
  *   - 本项目曾因为写入流程不完整(缺少同步等待)出现过
  *     "时间一直停在 1970 年"的现象 —— 计数器没真正写进去, 读出来永远是 0;
  *     正确的完整序列见 RTC_Init() 中的注释(WaitForSynchro -> SetCounter -> WaitForLastTask),
  *     三者的顺序与配合不能省;
  *   - 校时会让时间"跳变", 若正在做定时比较, 建议上层在跳变后重新计算一次差值。
  */
void RTC_SetEpoch(uint32_t epoch)
{
    RTC_SetCounter(epoch);
}

/* ==================== 初始化 ==================== */

/**
  * @brief  生成"默认时间": 优先取固件编译日期, 取不到时兜底为 2026-01-01 00:00:00
  * @param  无
  * @retval 默认时间戳(秒)
  *
  * 原理: __DATE__ 是编译器在编译时替换进去的字符串宏, 格式固定为
  *       "Mmm dd yyyy"(如 "Jan  5 2026", 注意日期为个位数时前面有空格)。
  *       用它当默认时间, 可以让"RTC 首次初始化但还没联网校时"这段窗口期
  *       也大致落在真实时间附近, 至少年份月份不会离谱到 1970。
  *
  *       解析过程
  *         1. sscanf 用 %*s 跳掉开头的星期缩写(某些编译器会给
  *            "Mon Jan  5 2026" 这种带星期的形式), 再取 3 字母月份 + 日 + 年;
  *         2. 用 strncmp 逐项比对月份缩写表换成 1~12 的月份号;
  *         3. 若解析结果不在 2020~2099 这个合理区间(例如 sscanf 失败,
  *            或者编译器给出了意料之外的格式), 整组字段退回 2026-01-01,
  *            宁可给一个"明显需要校时"的时间, 也不要写入随机值;
  *         4. 时分秒固定取 0, 因为 __DATE__ 里没有时间,
  *            想更准可以改用 __TIME__ 宏再补上。
  *
  *       注意: 编译日期只保证"不太离谱", 它不是真实时间 ——
  *       设备联网后必须由 NTP 校时覆盖, 这才是真正的时间来源。
  */
static uint32_t DefaultEpoch(void)
{
    static const char *mons[12] =
    { "Jan", "Feb", "Mar", "Apr", "May", "Jun",
      "Jul", "Aug", "Sep", "Oct", "Nov", "Dec" };
    char mon[4] = { 0 };
    int  d = 0, y = 0, mo = 0, h = 0, mi = 0, s = 0;
    int  i;

    if (sscanf(__DATE__, "%*s %3s %d %d", mon, &d, &y) >= 2)
    {
        for (i = 0; i < 12; i++)
        {
            if (strncmp(mon, mons[i], 3) == 0) { mo = i + 1; break; }
        }
    }
    if (y < 2020 || y > 2099 || mo < 1 || mo > 12 || d < 1 || d > 31)
    {
        y = 2026; mo = 1; d = 1;     /* 编译日期异常时的兜底 */
    }
    /* 时分秒固定为 0: __DATE__ 宏只含日期, 没有时间信息 */
    return RTC_ToEpoch((uint16_t)y, (uint8_t)mo, (uint8_t)d,
                       (uint8_t)h, (uint8_t)mi, (uint8_t)s);
}

/**
  * @brief  初始化 RTC: 首次上电配置时钟源与默认时间, 否则只恢复走时
  * @param  无
  * @retval 无
  *
  * 原理与流程
  *   0. 开 PWR/BKP 时钟并 PWR_BackupAccessCmd(ENABLE):
  *      STM32F1 复位后备份域(RTC 与 BKP 寄存器)是**写保护**的,
  *      不解锁备份访问, 后面所有 RTC 寄存器的写入都会被静默丢弃 ——
  *      这是"RTC 初始化代码看起来没错但时间永远不走"的最常见原因;
  *   1. 用 BKP_DR1 里的魔数 RTC_BKP_MAGIC 判断是否已经初始化过。
  *      BKP 寄存器由 VBAT 纽扣电池供电, 主电源掉电也**不丢**,
  *      因此这个标志真正区分的是"首次装配/换电池"与"普通重启";
  *   2. 【首次】等着 LSE 起振: 设一个自减计数上限作超时,
  *      不能让程序死等一个可能根本没焊晶振的时钟源;
  *        - LSE 就绪 -> 用 LSE(32.768kHz, 走时准, 且能被纽扣电池维持);
  *        - 超时未就绪 -> 打开 LSI(约 40kHz 内部 RC)并改选 LSI 作时钟源,
  *          代价是精度差(可能一天差几十秒), 但保证设备仍能走时,
  *          后续由 NTP 校时把误差拉回来;
  *   3. RCC_RTCCLKCmd(ENABLE) 使能 RTC 时钟;
  *   4. 预分频: RTC 每个时钟源周期加 1, 想得到 1 秒计数就要除以 32768,
  *      而寄存器里存的是"分频值 - 1", 所以写 32767;
  *      LSI 按约 40kHz 估算写 40000(本身有误差, 靠 NTP 校正);
  *   5. 写默认时间并落 BKP 魔数, 下次上电就走第 1 步的 else 分支;
  *   6. 【非首次】只需 RCC_RTCCLKCmd + RTC_WaitForSynchro 让影子寄存器
  *      重新与计数器同步, 时间由纽扣电池续着走, 不需要也不应该重置。
  *
  * 【写入时间的坑 —— 曾经导致时间一直停在 1970 年】
  *   RTC 的寄存器读写在 APB1 低速域, 而计数器在 32.768kHz 时钟域,
  *   跨时钟域靠影子寄存器同步, 因此必须严格按顺序:
  *       RTC_WaitForSynchro()   —— 等影子寄存器与 CNT 同步完成,
  *                                 否则接下来读到的可能是旧值/无效值;
  *       RTC_SetCounter(x)      —— 进入配置模式写 CNT 再退出;
  *       RTC_WaitForLastTask()  —— 等上一条写操作真正落到 RTC 域,
  *                                 否则紧接着的下一步写(如写预分频)
  *                                 会因为上一次还没写完而被丢弃。
  *   任何一个 Wait 省掉, 写入就可能不生效, 表现为时间永远停在 1970。
  *
  * 本函数只在上电时调用一次, 内部有阻塞等待(等 LSE 最多几十毫秒), 属正常。
  */
void RTC_Init(void)
{
    /* 使能 PWR 和 BKP 时钟; 其中 BKP 时钟是访问备份域寄存器的前提 */
    RCC_APB1PeriphClockCmd(RCC_APB1Periph_PWR | RCC_APB1Periph_BKP, ENABLE);
    PWR_BackupAccessCmd(ENABLE);            /* 解除备份域写保护(PWR_CR.DBP)。
                                               不解锁则所有 RTC/BKP 写入都被硬件丢弃, 且不报错 */

    if (BKP_ReadBackupRegister(RTC_BKP_REG) != RTC_BKP_MAGIC)
    {
        /* ---------- 首次上电: 完整初始化 RTC ---------- */
        printf("[RTC] 首次上电, 正在初始化 RTC...\r\n");

        /* 首选外部 32.768kHz 晶振 LSE */
        /* 打开 LSE 后起振需要时间(典型几百毫秒量级, 取决于晶振与负载电容),
           用自减计数作超时, 避免在没有焊接晶振的板子上死等 */
        RCC_LSEConfig(RCC_LSE_ON);
        {
            uint32_t wait = 0xFFFFF;
            while (RCC_GetFlagStatus(RCC_FLAG_LSERDY) == RESET)
            {
                if (--wait == 0) break;   /* 等待 LSE 就绪, 超时退出 */
            }
        }

        if (RCC_GetFlagStatus(RCC_FLAG_LSERDY) == RESET)
        {
            /* LSE 未起振(晶振缺失/未焊接), 回退到内部 LSI */
            printf("[RTC] LSE 未就绪, 使用内部 LSI 时钟\r\n");
            RCC_LSICmd(ENABLE);
            while (RCC_GetFlagStatus(RCC_FLAG_LSIRDY) == RESET)
            {
            }
            /* 降级用 LSI: 精度差(内部 RC, 随温度漂移), 但至少能走时 */
            RCC_RTCCLKConfig(RCC_RTCCLKSource_LSI);
        }
        else
        {
            printf("[RTC] 使用外部 LSE 晶振\r\n");
            RCC_RTCCLKConfig(RCC_RTCCLKSource_LSE);
        }

        RCC_RTCCLKCmd(ENABLE);              /* 使能 RTC 时钟(不使能则下面所有写操作都无效) */
        RTC_WaitForSynchro();               /* 等影子寄存器与 32.768kHz 域同步, 是后续读写的必要前提 */
        RTC_WaitForLastTask();              /* 等上一条写操作完成, 否则 RTC 会拒绝接收新的写命令 */
        /* 预分频: LSE=32768Hz 用 32767; LSI约40kHz 用 40000 (有误差但 NTP 会校正) */
        if (RCC_GetFlagStatus(RCC_FLAG_LSERDY) != RESET)
        {
            RTC_SetPrescaler(32767u);
        }
        else
        {
            RTC_SetPrescaler(40000u);
        }
        RTC_WaitForLastTask();
        RTC_SetEpoch(DefaultEpoch());       /* 写入默认时间; 内部是 WaitForSynchro->SetCounter->WaitForLastTask 序列 */
        BKP_WriteBackupRegister(RTC_BKP_REG, RTC_BKP_MAGIC);
                                            /* 魔数存进备份寄存器: 由纽扣电池保持,
                                               下次上电据此跳过整套初始化, 时间得以延续 */
        printf("[RTC] 初始化完成\r\n");
    }
    else
    {
        /* ---------- 已初始化: 直接启用时钟读取 ---------- */
        RCC_RTCCLKCmd(ENABLE);              /* 使能时钟并同步一次, 之后 RTC_GetCounter 才能读到正确值 */
        RTC_WaitForSynchro();
        printf("[RTC] 时间保持有效\r\n");
    }
}
